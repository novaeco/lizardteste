## Kconfig.projbuild
```kconfig
menu "NovaReptileElevage configuration"

config USE_PSRAM
    bool "Use PSRAM for LCD framebuffer"
    default y
    help
        Enable to allocate the LCD framebuffer in external PSRAM.
        Disable if PSRAM is unavailable or to force allocation in internal RAM.

endmenu
```

## components/st7262_rgb/Kconfig
```kconfig
menu "ST7262 RGB compatibility layer"

config ST7262_RGB_COMPAT
    bool "Enable legacy ST7262 RGB shim"
    default y
    help
        Ce module maintient la compatibilité avec l'ancien driver
        `st7262_rgb` en redirigeant toutes les initialisations vers le
        nouveau driver `st7701_rgb`, calibré pour la dalle Waveshare 7B
        1024x600. Désactivez cette option uniquement si plus aucun
        composant n'inclut les en-têtes historiques.

endmenu
```

## components/st7701_rgb/Kconfig
```kconfig
menu "ST7701 RGB configuration"

config ST7701_RGB_ENABLE
    bool "Enable ST7701 RGB panel support"
    default y
    help
        Enable support for the ST7701 RGB display driver used by the Waveshare ESP32-S3 Touch LCD 7B (1024x600).

endmenu
```

## sdkconfig.defaults
```kconfig
CONFIG_IDF_TARGET="esp32s3"
CONFIG_IDF_TARGET_ESP32S3=y

# PSRAM
CONFIG_SPIRAM=y
CONFIG_SPIRAM_BOOT_INIT=y
CONFIG_SPIRAM_USE_MALLOC=y
CONFIG_SPIRAM_ALLOW_BSS_SEG_EXTERNAL_MEMORY=y
CONFIG_FREERTOS_TASK_CREATE_ALLOW_EXT_MEM=y
CONFIG_SPIRAM_MODE_OCT=y
CONFIG_SPIRAM_SPEED_80M=y
CONFIG_SPIRAM_TYPE_ESPPSRAM64=y
CONFIG_SPIRAM_CLK_IO=30
CONFIG_SPIRAM_CS_IO=26

# Serial flasher configuration
CONFIG_ESPTOOLPY_FLASHMODE_DIO=y
CONFIG_ESPTOOLPY_FLASHMODE="dio"
CONFIG_ESPTOOLPY_FLASHFREQ_80M=y
CONFIG_ESPTOOLPY_FLASHFREQ="80m"
CONFIG_ESPTOOLPY_FLASHSIZE_16MB=y
CONFIG_ESPTOOLPY_FLASHSIZE="16MB"

# Use project-specific partition table
CONFIG_PARTITION_TABLE_CUSTOM=y
CONFIG_PARTITION_TABLE_CUSTOM_FILENAME="partitions.csv"
CONFIG_PARTITION_TABLE_OFFSET=0x8000

# Compiler configuration
CONFIG_COMPILER_OPTIMIZATION_PERF=y
CONFIG_COMPILER_STACK_CHECK_MODE_ALL=y

# ESP32-S3 CPU and cache configuration
CONFIG_ESP_DEFAULT_CPU_FREQ_MHZ_240=y
CONFIG_ESP_DEFAULT_CPU_FREQ_MHZ=240
CONFIG_ESP32S3_DEFAULT_CPU_FREQ_240=y
CONFIG_ESP32S3_DEFAULT_CPU_FREQ_MHZ=240
CONFIG_ESP32S3_INSTRUCTION_CACHE_32KB=y
CONFIG_ESP32S3_INSTRUCTION_CACHE_SIZE=0x8000
CONFIG_ESP32S3_DATA_CACHE_64KB=y
CONFIG_ESP32S3_DATA_CACHE_SIZE=0x10000
CONFIG_ESP32S3_DATA_CACHE_LINE_64B=y
CONFIG_ESP32S3_DATA_CACHE_LINE_SIZE=64

# LVGL configuration
CONFIG_LV_BUILD_EXAMPLES=n
CONFIG_LV_FONT_MONTSERRAT_12=y
CONFIG_LV_FONT_MONTSERRAT_18=y
CONFIG_LV_FONT_MONTSERRAT_24=y

# SPI configuration
CONFIG_SPI_MASTER_ISR_IN_IRAM=y

# I2C configuration
CONFIG_I2C_MASTER_ISR_HANDLER_IN_IRAM=y

# GPIO configuration
CONFIG_GPIO_CTRL_FUNC_IN_IRAM=y

# ESP timer configuration
CONFIG_ESP_TIMER_TASK_STACK_SIZE=4096
CONFIG_ESP_TIMER_PROFILING=y

# FreeRTOS configuration
CONFIG_FREERTOS_HZ=1000
CONFIG_FREERTOS_IDLE_TASK_STACKSIZE=2048
CONFIG_FREERTOS_TIMER_TASK_STACK_DEPTH=4096
CONFIG_FREERTOS_ISR_STACKSIZE=2048

# Heap memory debugging
CONFIG_HEAP_POISONING_LIGHT=y
CONFIG_HEAP_TASK_TRACKING=y

# Logging
CONFIG_LOG_DEFAULT_LEVEL_INFO=y
CONFIG_LOG_COLORS=y
CONFIG_LOG_TIMESTAMP_SOURCE_SYSTEM=y

# Wi-Fi
CONFIG_ESP_WIFI_ENABLED=n
CONFIG_ESP_WIFI_SOFTAP_SUPPORT=n

# LWIP tuning
CONFIG_LWIP_MAX_SOCKETS=10
CONFIG_LWIP_TCP_SND_BUF_DEFAULT=16384
CONFIG_LWIP_TCP_WND_DEFAULT=32768

# Power management
CONFIG_PM_ENABLE=y
CONFIG_PM_DFS_INIT_AUTO=y
```
